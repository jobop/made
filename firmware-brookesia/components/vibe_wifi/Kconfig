## firmware-brookesia/components/vibe_wifi/Kconfig
```kconfig
menu "Vibe Wi-Fi fallback"

    config VIBE_WIFI_SSID
        string "Fallback Wi-Fi SSID (leave empty to use saved credentials)"
        default ""
        help
            Used only when no credentials have been saved through vibe_wifi
            and no ESP-IDF STA configuration already exists in Wi-Fi NVS.

    config VIBE_WIFI_PASSWORD
        string "Fallback Wi-Fi password"
        default ""
        help
            Leave empty for an open network. For WPA2/WPA3, use 8 to 63
            characters. This value is stored in local sdkconfig, so keep a
            configured sdkconfig with credentials out of shared repositories.

endmenu
```

## made/sdkconfig.defaults
```kconfig
CONFIG_IDF_TARGET="esp32s3"
CONFIG_ESPTOOLPY_FLASHMODE_QIO=y
CONFIG_ESPTOOLPY_FLASHSIZE_16MB=y
CONFIG_PARTITION_TABLE_CUSTOM=y
CONFIG_COMPILER_OPTIMIZATION_PERF=y
CONFIG_SPIRAM=y
CONFIG_SPIRAM_MODE_OCT=y
CONFIG_SPIRAM_FETCH_INSTRUCTIONS=y
CONFIG_SPIRAM_RODATA=y
CONFIG_SPIRAM_SPEED_80M=y
CONFIG_SPIRAM_MALLOC_ALWAYSINTERNAL=0
CONFIG_SPIRAM_TRY_ALLOCATE_WIFI_LWIP=y
CONFIG_ESP_DEFAULT_CPU_FREQ_MHZ_240=y
CONFIG_ESP_CONSOLE_UART_CUSTOM=y
CONFIG_ESP_CONSOLE_SECONDARY_NONE=y
# CONFIG_ESP_CONSOLE_SECONDARY_USB_SERIAL_JTAG is not set
CONFIG_ESP_CONSOLE_UART_BAUDRATE=2000000
CONFIG_FREERTOS_HZ=1000
CONFIG_ESP_BROOKESIA_ENABLE_AI_FRAMEWORK=n
CONFIG_ESP_BROOKESIA_GUI_ENABLE_ANIM_PLAYER=n
CONFIG_ESP_BROOKESIA_ENABLE_SERVICES=n
CONFIG_ESP_BROOKESIA_SYSTEMS_ENABLE_SPEAKER=n
CONFIG_BOOST_MATH_ENABLED=n
CONFIG_BOOST_SERIALIZATION_ENABLED=n
CONFIG_LV_USE_CLIB_MALLOC=y
CONFIG_LV_USE_CLIB_STRING=y
CONFIG_LV_USE_CLIB_SPRINTF=y
# CONFIG_LV_OS_FREERTOS is not set
CONFIG_LV_DEF_REFR_PERIOD=15
CONFIG_LV_OBJ_STYLE_CACHE=y
CONFIG_LV_FONT_MONTSERRAT_12=y
CONFIG_LV_FONT_MONTSERRAT_14=y
CONFIG_LV_FONT_MONTSERRAT_16=y
CONFIG_LV_FONT_MONTSERRAT_26=y
CONFIG_LV_FONT_SOURCE_HAN_SANS_SC_16_CJK=y
CONFIG_LV_FONT_FMT_TXT_LARGE=y
CONFIG_LV_USE_IMGFONT=y
CONFIG_LV_USE_KEYBOARD=y
CONFIG_LV_BUILD_EXAMPLES=n
CONFIG_LV_BUILD_DEMOS=n
CONFIG_MBEDTLS_CERTIFICATE_BUNDLE=y
CONFIG_MBEDTLS_CERTIFICATE_BUNDLE_DEFAULT_FULL=y
CONFIG_MBEDTLS_HAVE_TIME_DATE=y
CONFIG_LV_DRAW_SW_DRAW_UNIT_CNT=1
CONFIG_SPIRAM_XIP_FROM_PSRAM=y
CONFIG_BSP_SPIFFS_PARTITION_LABEL="assets"
CONFIG_ESP32S3_INSTRUCTION_CACHE_32KB=y
CONFIG_ESP32S3_DATA_CACHE_64KB=y
CONFIG_ESP32S3_DATA_CACHE_LINE_64B=y
CONFIG_COMPILER_OPTIMIZATION_PERF=y
CONFIG_ESP_LVGL_ADAPTER_ENABLE_FPS_STATS=y
CONFIG_SR_WN_WN9_NIHAOXIAOZHI_TTS=y
CONFIG_XIAOZHI_APP_UI_LANGUAGE_SIMPLIFIED_CHINESE=y
CONFIG_XIAOZHI_APP_TRANSPORT_WEBSOCKET=y
CONFIG_XIAOZHI_INFO_TIMEOUT_MS=8000

CONFIG_LV_OS_NONE=y

CONFIG_LV_USE_QRCODE=y
```

## receiver-firmware/main/Kconfig.projbuild
```kconfig
menu "Made receiver"
config VIBE_RECEIVER_UART_TRANSPORT
    bool "Use UART0 through a USB-to-serial adapter"
    depends on IDF_TARGET_ESP32C3
    default n
    help
        For ESP32-C3 development boards whose USB connector uses a WCH
        USB-to-UART adapter. Protocol uses UART0 at 921600 baud, TX GPIO21,
        RX GPIO20. Select console NONE so logs do not share this transport.
endmenu
```
